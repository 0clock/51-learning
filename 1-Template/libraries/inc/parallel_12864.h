/*********************************************************************************************************
** 文件功能 ：12864液晶并行驱动程序
** 注意事项 ：硬件部分需要将12864的第15个管脚通过电阻接到高电平
** 工程作者 ：Blue Sky Teams——ZZL
** 工程版本 ：V1.0
*********************************************************************************************************/

#include "main.h"
#define uint unsigned int
#define uchar unsigned char
/*********************************************************************************************************
**            CE----------P0^5	  OUT
**			  RW----------P0^6	  OUT
**            RS----------P0^7	  OUT
**            date--------P2 1~7  IN/OUT
***************************************液晶管脚接口定义*******************************************************/
sbit	 CE     	=P2^3;
sbit	 RW     	=P2^2;
sbit	 RS	    	=P2^1;

#define  DATA_PORT	P0

#define basic_commod  0x30
#define extern_commod 0x34
#define cursor_on	  0x0f
#define cursor_off	  0x0c
#define clear 		  0x01
#define draw_on		  0x36
#define draw_off	  0x34

uchar code addr_tab[] = {

0x80,0x81,0x82,0x83,0x84,0x85,0x86,0x87,//第一行汉字位置
0x90,0x91,0x92,0x93,0x94,0x95,0x96,0x97,//第二行汉字位置
0x88,0x89,0x8a,0x8b,0x8c,0x8d,0x8e,0x8f,//第三行汉字位置
0x98,0x99,0x9a,0x9b,0x9c,0x9d,0x9e,0x9f,//第四行汉字位置

};

/*********************************************************************************************************
** 函数名称 ：void Check_12864_Busy(void)
** 函数功能 ：读忙碌状态
** 函数说明 ：若12864处于忙碌，等待直到空闲状态
** 入口参数 ：无
** 出口参数 ：无
*********************************************************************************************************/
void Check_12864_Busy(void)
{
	uchar flag = 0 , i;
	DATA_PORT = 0XFF;
	RS = 0;
	RW = 1;
	while(flag == 0)
	{
		for(i = 0;i ++;i< 10)
		{
			_nop_();_nop_(); _nop_();_nop_();		
		}
		CE = 1;
		for(i = 0;i ++;i < 10)
		{
			_nop_();_nop_(); _nop_();_nop_();		
		}
		if(DATA_PORT & 0X80)flag = 0;
		else flag = 1;
		for(i = 0;i ++ ;i < 10)
		{
			_nop_();_nop_(); _nop_();_nop_();		
		}
		CE = 0;
	}		
}
/*********************************************************************************************************
** 函数名称 ：Write_12864_Data(uchar date)
** 函数功能 ：写数据
** 函数说明 ：
** 入口参数 ：待写入数据
** 出口参数 ：无
*********************************************************************************************************/
void Write_12864_Data(uchar date)//写数据
{
	uchar i;
	Check_12864_Busy();
	RS = 1;
	RW = 0;
	for(i = 0;i ++;i < 4)
	{
		_nop_();_nop_(); _nop_();_nop_();		
	}
	CE = 1;
	for(i = 0;i ++ ;i < 4)
	{
		_nop_();_nop_(); _nop_();_nop_();		
	}
	DATA_PORT = date;
	for(i = 0;i ++;i < 4)
	{
		_nop_();_nop_(); _nop_();_nop_();		
	}
	CE = 0;
}
/*********************************************************************************************************
** 函数名称 ：uchar Read_12864_Data(void)
** 函数功能 ：读数据
** 函数说明 ：
** 入口参数 ：无
** 出口参数 ：待读出数据
*********************************************************************************************************/
uchar Read_12864_Data(void)//读数据
{
	uchar date,i;
	Check_12864_Busy();
	DATA_PORT = 0XFF;
	RS = 1;
	_nop_();_nop_();_nop_();_nop_();
	date = DATA_PORT;
	RW = 1;
	for(i = 0;i ++ ;i < 10)
	{
		_nop_();_nop_(); _nop_();_nop_();		
	}
	CE = 1;
	for(i = 0;i ++;i < 10)
	{
		_nop_();_nop_(); _nop_();_nop_();		
	}
	date = DATA_PORT;
	CE = 0;		
	return(date);		
}
/*********************************************************************************************************
** 函数功能 ：读数据
** 函数说明 ：
** 入口参数 ：待写入的指令
** 出口参数 ：无
*********************************************************************************************************/
void Write_12864_Com(uchar commod)//写指令
{
	uchar i;
	Check_12864_Busy();
	RS = 0;
	RW = 0;
	for(i = 0;i ++;i < 4)
	{
		_nop_();_nop_(); _nop_();_nop_();		
	}
	CE = 1;
	for(i = 0;i ++;i < 4)
	{
		_nop_();_nop_(); _nop_();_nop_();		
	}
	DATA_PORT = commod;
	for(i = 0;i ++;i < 4)
	{
		_nop_();_nop_(); _nop_();_nop_();		
	}
	CE = 0;
}
/*********************************************************************************************************
** 函数功能 ：12864液晶初始化程序
** 函数说明 ：
** 入口参数 ：无
** 出口参数 ：无
*********************************************************************************************************/

void LCD_12864_Init(void) 
{ 
	Write_12864_Com(basic_commod);//30H--基本指令操作 
	Write_12864_Com(cursor_off);//0x06开显示，关光标，不闪烁。 扩展
	Write_12864_Com(clear);//清除显示0x01 
	Write_12864_Com(0x06);//指定在资料写入或读取时，光标的移动方向，DDRAM的地址计数器（AC）加1。 

} 

/*********************************************************************************************************
** 函数功能 ：向液晶连续写入一段字符串
** 函数说明 ：字符可以是任何字符，包括汉字，但是汉字必须是写在一个连续的16*16的点阵中
** 函数举例 ：Write_12864_String("LCD12864液晶实验")，这段字符串有8个英文字符，总共占4个16*16的点阵，后面的四个同样占4个16*16的点阵
** 错误举例 ：Write_12864_String("LCD液晶显示"),前面的三个字符占了一个半的16*16单元的点阵，会导致后面的汉字没法正常显示
** 入口参数 ：待写入的字符串
** 出口参数 ：无
*********************************************************************************************************/
void Write_12864_String(uchar *str)//写入字符串或者汉字
{
	uchar *p;
	p = str;
	while(*p != 0)
	{
		Write_12864_Data(*p);
		p = ++str;
	}	
}

/*********************************************************************************************************
** 函数功能 ：在指定位置写入汉字
** 函数说明 ：汉字必须是写在一个连续的16*16的点阵中
** 入口参数 ：待写入的汉字
** 函数举例 ：Hanzi_Disp("液晶实验")
** 出口参数 ：无
*********************************************************************************************************/
void Hanzi_Disp(uchar x,uchar y,uchar *s)
{ 
	Write_12864_Com(addr_tab[8 * x + y]);  //写地址
	while(*s > 0)
	   { 
			Write_12864_Data(*s);    //写数据
			s ++;     
	   }
}
/*********************************************************************************************************
** 函数功能 ：在指定位置写一个整数
** 函数说明 ：整数的范围从0到65535
** 入口参数 ：待写入的整数
** 出口参数 ：无
*********************************************************************************************************/
void Num_Display(uchar x,uchar y,uint number)
{
	uint i = 10000;
	Write_12864_Com(addr_tab[8 * x + y]);  //写地址
	if( number !=0)
	{
		while(number / i == 0)
		{
			i /= 10;
		}	
		if(i != 1)
		{
			while(number/i != 0)
			{
				Write_12864_Data(number / i + 0x30);
				number -= (number / i) * i;	
				i /= 10;	
				if(i == 1)break;
			}		
		}	
	}
	Write_12864_Data(number%10+0x30);
}
/*********************************************************************************************************
** 函数功能 ：在屏幕上显示一副图片
** 函数说明 ：可以有半屏显示和全屏显示两种模式，可以自行修改
** 画图方式为从左到右扫描，从上到下，每写一个字节后行地址加一，每写玩16个字节，即128个点（如果半屏显示8个字节，64个点）列地址加一
** 点阵取点方式为从左到右，从上到下，高位在前，低为在后
** 入口参数 ：绘画的图片的首地址
** 出口参数 ：无
*********************************************************************************************************/
void PHO_Display(const unsigned char *s) 
{ 
	uchar COUNT3 = 0X02,COUNT1,COUNT2,LCD_X = 0X80,LCD_Y;
		 
	for (;COUNT3 != 0;COUNT3 --) 
	{ 
		LCD_Y = 0X80; //上半屏
		COUNT2 = 0X20;//32 
		for(;COUNT2 != 0;COUNT2 --) 
		{ 
	//		COUNT1 = 0X10;//8个16*16点阵单元 显示全屏		
			COUNT1 = 0X08;//4个16*16点阵单元 显示半屏 华师logo
			Write_12864_Com(0x34); 
			Write_12864_Com(LCD_Y); 
			Write_12864_Com(LCD_X); 
			Write_12864_Com(0x30); 
			for (;COUNT1 != 0;COUNT1 --) 
			{ 
				Write_12864_Data(*s ++); 		
			} 
			LCD_Y += 1; 
		} 
		LCD_X = 0X88; //下半屏
	} 
	Write_12864_Com(0x36); 
	Write_12864_Com(0x30); 
}
/*另外一种打点画图程序*/
void img_displeft(const unsigned char *img)  //  注意0---31，0---31上下分半
{
    unsigned char i,j,m,n;
  for(j = 0;j < 32;j ++)
     {
       for(i = 0;i < 4;i ++)
       {
         Write_12864_Com(0x34); //扩展指令，显示绘图
         Write_12864_Com(0x80 + j); //更新坐标
         Write_12864_Com(0x80 + i);
         Write_12864_Com(0x30); //基本指令集
         Write_12864_Data(img[j * 8 + i *2 ]);  //高字节
         Write_12864_Data(img[j * 8 + i * 2 + 1]); //低字节
       }
     }  
  for(n = 0;n < 32;n ++)
     {
       for(m = 0;m < 4;m ++)
       {
         Write_12864_Com(0x34); //扩展指令，显示绘图
         Write_12864_Com(0x80 + n); //更新坐标
         Write_12864_Com(0x88 + m);
         Write_12864_Com(0x30); //基本指令集
         Write_12864_Data(img[n * 8 + 256 + m * 2]);  //高字节
         Write_12864_Data(img[n * 8 + 256 + m * 2 + 1]); //低字节
       }
     }
     Write_12864_Com(0x36); //扩充功能指令，开绘图开关。
} 
/*********************************************************************************************************
** 函数功能 ：清除12864内部的CGRAM
** 函数说明 ：当屏幕之前通过CGRAM绘图，可以调用此函数来清除CGRAM中的内容
** 入口参数 ：无
** 出口参数 ：无
*********************************************************************************************************/
void Clear_12864(void)
{
	uchar COUNT3 = 0X02,COUNT1,COUNT2,LCD_X = 0X80,LCD_Y;
		 
	for (;COUNT3 != 0;COUNT3 --) 
	{ 
		LCD_Y = 0X80; 
		COUNT2 = 0X20;//32 
		for(;COUNT2 != 0;COUNT2 --) 
		{ 
			COUNT1 = 0X10;//16 
			Write_12864_Com(0x34); 
			Write_12864_Com(LCD_Y); 
			Write_12864_Com(LCD_X); 
			Write_12864_Com(0x30); 
			for (;COUNT1 != 0;COUNT1 --) 
			{ 
				Write_12864_Data(0x00); 		
			} 
			LCD_Y += 1; 
		} 
		LCD_X = 0X88; 
	} 
	Write_12864_Com(0x36); 
	Write_12864_Com(0x30); 	
}
/*********************************************************************************************************
** 函数功能 ：在屏幕上打上一个点，屏幕像素是128*64
** 函数说明 ：打点范围不要超过坐标范围，这个函数用来为后面的画直线和其他函数服务
** 入口参数 ：待写入的整数
** 出口参数 ：无
*********************************************************************************************************/



void Set_12864_Point(uchar x,uchar y,uchar z)
{
    uchar i	= 0;
	uchar j = 0;
	uint num = 0;
	uint last_num = 0;
	Write_12864_Com(0x34);        //打开扩展指令集
	Write_12864_Com(0x34);        //打开扩展指令集
	num = (z > 0? 0x8000:0);
	if( y <= 32 )
	{
		i += y;
		j = (x - 1) / 16;
		x = ( x%16>0? (x%16):16 ) - 1 ;
		num = num >> x;				
	}
	else
	{
		i = y - 32;	
		j = ( (x - 1) / 16 ) + 8;
		x = ( x%16>0? (x%16):16 ) - 1 ;
		num = num >> x;		
	}
	Write_12864_Com(0x80 + i - 1);
	Write_12864_Com(0x80 + j);
	Read_12864_Data();	
	last_num = Read_12864_Data();
	last_num <<= 8; 
	last_num |= Read_12864_Data();
	num = last_num | num;
	Write_12864_Com(0x80 + i - 1);
	Write_12864_Com(0x80 + j);	
	Write_12864_Data(num / 256);
	Write_12864_Data(num % 256);
  Write_12864_Data(0x36);        //打开绘图显示
	Write_12864_Data(0x30);        //回到基本指令集

}
/*********************************************************************************************************
** 函数名称 ：void LCD_12864_DrawLine(uint x1, uint y1, uint x2, uint y2)
** 函数功能 ：在12864屏幕上画一条直线
** 函数说明 ：因分辨率较低，斜线并不完美
** 入口参数 ：x1:起点横坐标
			  y1:起点纵坐标
			  x2:终点横坐标		   
			  y2:终点纵坐标
** 出口参数 ：当前的键盘值
*********************************************************************************************************/
void LCD_12864_DrawLine(uint x1, uint y1, uint x2, uint y2)
{
	uint t; 
	int xerr = 0,yerr = 0,delta_x,delta_y,distance; 
	int incx,incy,uRow,uCol; 

	delta_x = x2-x1; //计算坐标增量 
	delta_y = y2-y1; 
	uRow = x1; 
	uCol = y1; 
	if(delta_x > 0)incx = 1; //设置单步方向 
	else if(delta_x == 0)incx = 0;//垂直线 
	else {incx = -1;delta_x = - delta_x;} 
	if(delta_y > 0)incy = 1; 
	else if(delta_y == 0)incy = 0;//水平线 
	else{incy = -1;delta_y = -delta_y;} 
	if( delta_x > delta_y)distance = delta_x; //选取基本增量坐标轴 
	else distance = delta_y; 
	for(t = 0;t <= distance + 1;t ++ )//画线输出 
	{  
		Set_12864_Point(uRow,uCol,1);//画点 
		xerr += delta_x ; 
		yerr += delta_y ; 
		if(xerr > distance) 
		{ 
			xerr -= distance; 
			uRow += incx; 
		} 
		if(yerr > distance) 
		{ 
			yerr -= distance; 
			uCol += incy; 
		} 
	}  
}  	 

