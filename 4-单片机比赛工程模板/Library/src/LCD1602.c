/*********************************************************************************************************
** 文件功能 ：LCD1602驱动程序
** 工程作者 ：Blue Sky Teams——ZZL
** 工程版本 ：V1.0
*********************************************************************************************************/
#include "LCD1602.h"

/*********************************************************************************************************
** 函数功能 ：读写LCD1602时用于读写时序的时钟延时
** 入口参数 ：z：延时长度
** 出口参数 ：无
*********************************************************************************************************/	 
void LCD_Delay(unsigned char z)
{
	unsigned char x,y;
	for(x = z;x > 0;x --)
		for(y = 50;y>0;y--);
}

/*********************************************************************************************************
** 函数功能 ：LCD1602忙碌查询
** 函数说明 ：每次读写液晶时需要事先检测芯片是否处于忙碌状态
** 入口参数 ：无
** 出口参数 ：返回值为1：等待超时
**            返回值为0：芯片处于空闲状态
*********************************************************************************************************/
unsigned char Check_1602_Busy(void)
{
	unsigned int time=0;
	RS_1602 = 0;
	RW_1602 = 1;
	EN_1602 = 1;
	while( (LCD_PORT&0X80) != 0X00)
	{
		time ++;
		if(time > 1000) return 1;//实际测量会遇到有些型号的液晶BF一直为高，如果等待超时跳出循环	
	}	
	return 0;
}

/*********************************************************************************************************
** 函数功能 ：向液晶写入指令
** 函数说明 ：
** 入口参数 ：待写入的指令
** 出口参数 ：无
*********************************************************************************************************/
void Write_1602_Com(unsigned char zhiling)//写指令
{
	Check_1602_Busy();	//读忙碌状态，等待液晶处于空闲
	RS_1602 = 0;		//RS_1602为低电平
	RW_1602 = 0;		//RW_1602为低电平
	EN_1602 = 1;
	LCD_PORT = zhiling;	//准备好数据口的数据
	LCD_Delay(1);		//根据时序要求，延时一段时间，等待数据口数据稳定
	EN_1602 = 0;		//产生一个下降沿，将数据口的数据读入到液晶中
	LCD_Delay(1);

}

/*********************************************************************************************************
** 函数功能 ：向液晶写入数据
** 函数说明 ：
** 入口参数 ：待写入的数据，数据为LCD1062用来做显示用的，比如说shuju = 0x30，则显示“0”，
** 			  现成的字符数据可查询"LCD1602液晶完整中文资料.pdf"中“CGROM中字符码与字字符字模关系对照表”
** 出口参数 ：无
*********************************************************************************************************/
void Write_1602_Data(unsigned char shuju)//写数据
{
	Check_1602_Busy();
	RS_1602 = 1;
	RW_1602 = 0;
	EN_1602 = 1;
	LCD_PORT = shuju;
	LCD_Delay(1);
	EN_1602 = 0;	
	LCD_Delay(1);

}

/*********************************************************************************************************
** 函数功能 ：在指定位置连续写入一串字符
** 函数说明 ：注意写入字符串的长度，不要超过屏幕单行的显示范围
** 入口参数 ：str：   待写入字符串首地址
**            addr：  写入液晶显示的地址
** 出口参数 ：无
*********************************************************************************************************/
void Write_1602_String(unsigned char *str,unsigned char addr)
{
	Write_1602_Com(addr);
	while(*str)
	{
		Write_1602_Data(*str);
		str++;
	}	
}

/*********************************************************************************************************
** 函数功能 ：在指定位置写入一个整数
** 函数说明 ：整数的范围从0~65535，更大的需要采用long整型的进行扩展，注意整数的位数和地址不要超出显示范围
** 入口参数 ：number：待写入的整数
**            addr：  写入液晶显示的地址
** 出口参数 ：无
*********************************************************************************************************/
void Write_Num(unsigned int number,unsigned char addr)
{
	Write_1602_Com(addr);
	if(number/10000 != 0)
	{
		Write_1602_Data(0x30 + number/10000);
		Write_1602_Data(0x30 + number%10000/1000);
		Write_1602_Data(0x30 + number%1000/100);
		Write_1602_Data(0x30 + number%100/10);
		Write_1602_Data(0x30 + number%10);
	}	
	else if(number/1000 != 0)
	{
		Write_1602_Data(0x30 + number/1000);
		Write_1602_Data(0x30 + number%1000/100);
		Write_1602_Data(0x30 + number%100/10);
		Write_1602_Data(0x30 + number%10);	
	}	
	else if(number/100 != 0)
	{
		Write_1602_Data(0x30 + number/100);
		Write_1602_Data(0x30 + number%100/10);
		Write_1602_Data(0x30 + number%10);		
	}
	else if(number/10 != 0)
	{
		Write_1602_Data(0x30 + number/10);
		Write_1602_Data(0x30 + number%10);			
	}
	else Write_1602_Data(0x30 + number);
}


/*********************************************************************************************************
** 函数功能 ：液晶初始化
** 函数说明 ：用液晶之前需要先初始化液晶，配置对应的显示模式
** 入口参数 ：time:需要延时的时间，单位ms
** 出口参数 ：无
*********************************************************************************************************/
void LCD_1602_Init()//初始化
{
	Write_1602_Com(DISPLAY_MOD | DISPLAY_MOD_TWO_LINE | DISPLAY_MOD_5_7);//设置显示模式，两行显示，字符点阵大小为5*7:0X38

	Write_1602_Com(DISPLAY_SET | DISPLAY_SET_ON | DISPLAY_SET_CURSOR_OFF | DISPLEY_SET_BLINK_OFF);//开显示，不显示光标，光标不闪烁:0X0F
		
	Write_1602_Com(SET_MOD | SET_MOD_AC_ADD | SET_MOD_MOVE_OFF);//设置写入数据后指针AC加一,画面不动：0X06

	Write_1602_Com(CLEAR_SCREEN);//清屏
	Write_1602_Com(CURSOR_RESET);
	Write_1602_Com(0x80);
}




